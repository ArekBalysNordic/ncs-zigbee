## west.yml
```yaml
# Copyright (c) 2024 Nordic Semiconductor ASA
# SPDX-License-Identifier: Apache-2.0

manifest:
  remotes:
    - name: ncs
      url-base: https://github.com/nrfconnect
    - name: ArekBalysNordic
      url-base: https://github.com/ArekBalysNordic

  projects:
    - name: nrf
      remote: ArekBalysNordic
      repo-path: sdk-nrf
      revision: pm_removal
      import: true
```
